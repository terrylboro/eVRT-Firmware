## CMakeLists.txt
```
cmake_minimum_required(VERSION 3.20.0)
find_package(Zephyr REQUIRED HINTS $ENV{ZEPHYR_BASE})
project(audio_max98357a_sd)

target_sources(app PRIVATE
    src/main.c
    ../../modules/audio/audio_playback.c
)

target_include_directories(app PRIVATE
    ../../modules/audio
)
```

## prj.conf
```kconfig
CONFIG_PRINTK=y
CONFIG_CONSOLE=y
CONFIG_SERIAL=y
CONFIG_USE_SEGGER_RTT=y
CONFIG_RTT_CONSOLE=y
CONFIG_UART_CONSOLE=n

CONFIG_I2S=y
CONFIG_GPIO=y
CONFIG_SPI=y
CONFIG_DISK_ACCESS=y
CONFIG_FILE_SYSTEM=y
CONFIG_FAT_FILESYSTEM_ELM=y
CONFIG_LOG=y

CONFIG_SD_RETRY_COUNT=20
CONFIG_SD_CMD_RETRIES=3
CONFIG_SD_INIT_TIMEOUT=3000
CONFIG_SD_CMD_TIMEOUT=500

CONFIG_MAIN_STACK_SIZE=4096
CONFIG_HEAP_MEM_POOL_SIZE=16384
```

## src/main.c
```c
#include <zephyr/kernel.h>
#include <zephyr/sys/printk.h>

#include "audio_playback.h"

#define AUDIO_TEST_FILE "INST.WAV"

int main(void)
{
    int ret;

    printk("MAX98357A SD WAV playback baseline\n");

    ret = audio_playback_init();
    if (ret) {
        printk("Audio init failed: %d\n", ret);
        return ret;
    }

    ret = audio_playback_set_volume(100);
    if (ret) {
        printk("Audio volume setup failed: %d\n", ret);
        return ret;
    }

    ret = audio_playback_play_file(AUDIO_TEST_FILE);
    if (ret) {
        printk("Audio playback failed: %d\n", ret);
        return ret;
    }

    printk("Audio playback complete\n");
    return 0;
}
```
